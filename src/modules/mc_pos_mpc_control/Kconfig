## src/modules/mc_pos_mpc_control/Kconfig
```kconfig
menuconfig MODULES_MC_POS_MPC_CONTROL
	bool "mc_pos_mpc_control"
	default n
	---help---
		Enable support for mc_pos_mpc_control

menuconfig USER_MC_POS_MPC_CONTROL
	bool "mc_pos_mpc_control running as userspace module"
	default n
	depends on BOARD_PROTECTED && MODULES_MC_POS_MPC_CONTROL
	---help---
		Put mc_pos_mpc_control in userspace memory
```

## src/modules/sc_external_wrench/Kconfig
```kconfig
menuconfig MODULES_SC_EXTERNAL_WRENCH
	bool "sc_external_wrench"
	default n
	---help---
		Enable support for sc_external_wrench
```

## src/modules/sc_mpc_control/Kconfig
```kconfig
menuconfig MODULES_SC_MPC_CONTROL
	bool "sc_mpc_control"
	default n
	---help---
		Enable support for sc_mpc_control

menuconfig USER_SC_MPC_CONTROL
	bool "sc_mpc_control running as userspace module"
	default y
	depends on BOARD_PROTECTED && MODULES_SC_MPC_CONTROL
	---help---
		Put sc_mpc_control in userspace memory
```
